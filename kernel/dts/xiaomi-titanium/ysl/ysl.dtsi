#include "display.dtsi"
#include "touchscreen.dtsi"
#include "audio.dtsi"
#include "misc.dtsi"
#include "camera.dtsi"
#include "pinctrl.dtsi"
#include "ysl-pinctrl.dtsi"
#include "battery.dtsi"
#include "fingerprint.dtsi"
#include "pmic.dtsi"